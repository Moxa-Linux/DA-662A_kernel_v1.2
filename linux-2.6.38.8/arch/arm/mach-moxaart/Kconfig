## linux-2.6.38.8/arch/arm/mach-moxaart/Kconfig
```kconfig
# FIXME: Add your own platform here
menu "Moxa CPU Implementation Options"

comment "Moxa CPU Platforms"

config ARCH_MOXAART_DRAM_SIZE
	hex "Set the DRAM size"
	depends on ARCH_MOXAART
	default '0x2000000'

config MACH_MOXAART
	bool "MACH MOXA ART"
	help
	  Say 'Y' here if you want your kernel to support Intel's
	  KIXRP435 Reference Platform.
	  For more information on this platform, see <file:Documentation/arm/IXP4xx>.
choice
prompt "Select Moxa Product Type"
default ARCH_IA240

config ARCH_IA3341
	bool "Support for Moxa IA3341 Development Platform"
	depends on ARCH_MOXACPU

config ARCH_IA240
	bool "MOXA IA240"
	depends on MACH_MOXAART

config ARCH_IA241
	bool "MOXA IA241"
	depends on MACH_MOXAART

config ARCH_W321
	bool "Moxa W321"
	depends on ARCH_MOXAART

config ARCH_W341
	bool "Moxa W341"
	depends on ARCH_MOXAART

endchoice
endmenu
```

## linux-2.6.38.8/arch/arm/mach-moxacpu/Kconfig
```kconfig
# FIXME: Add your own platform here
menu "Moxa ART CPU Implementation Options"

comment "Moxa ART CPU Platforms"

config ARCH_CPE
	bool "Support for Moxa CPE Development Platform"
	depends on ARCH_MOXACPU
	default y

config ARCH_MOXACPU_TICK
        int "System tick(Hz) for CV request"
        depends on ARCH_MOXACPU
        default '100'

config ARCH_IA240
	bool "Support for Moxa IA240 Development Platform"
	depends on ARCH_MOXACPU

config MACH_MOXACPU
	bool "MACH_MOXACPU"
	help
	  Say 'Y' here if you want your kernel to support Moxa's
	  ART CPU Reference Platform.

endmenu
```

## linux-2.6.38.8/arch/arm/mach-moxamacro/Kconfig
```kconfig
# arch/arm/mach-moxamacro/Kconfig
#
# Copyright 2011 Moxa Tech., Inc.
# 	Vincent Wu.<vincent.wu@moxa.com>
# 	http://www.moxa.com/
#
# Licensed under GPLv2

# Configuration options for the MOXA Macro CPU

menu "Moxa Macro Implementation Options"
comment "Moxa Macro Platforms"

config CPU_MOXAMACRO
	bool
	select ARCH_REQUIRE_GPIOLIB
	help
	  Enable MOXA Macro CPU support

config MACH_MOXAMACRO
	bool "MOXAMACRO"
	select CPU_MOXAMACRO
#select PCI
	help
	  Machine support for the MOXA Macro 
endmenu

config DECOMPRESS_UART_PORT
	int "Kernel decompressing debug uart port"
	default 0
	help
	  The debug uart port utilized when kernel decompressing.

config PCIE
	bool "PCIE support"
	help
	  MOXAMACRO Full-Function with PCIE

config MOXAMACRO_REMAP
	bool "MOXA MACRO Hardware Remap"
	help
	  If the boot loader remapped the RAM address to 0x0, say yes,
	  and if it did not or unsure, say no.

config MOXAMACRO_DDR2_SDRAM
	bool "MOXA MACRO DDR2 SDRAM Version"
	help
	  If the main memory is DDR2 SDRAM at 0x80000000 (phy), say yes.
	  If the main memory is SDR SDRAM at 0x60000000 (phy), say no.
```
